# STM32F101xx register map
File version: 1.1
Registers are 32-bit, read-write, reset 0x0 unless marked. A register's access mark holds for its fields unless they carry their own. Offsets are from the block's base; lines under a group give offsets from that group; [hi:lo] are bit positions; {n}, {i} and the like mark numbered series; 'fields as' and 'values as' point back to an identical list; <NAME> marks a mode.

## Memory map
0x40000000 TIM2 size 0x400 — General purpose timer
0x40000400 TIM3 size 0x400
0x40000800 TIM4 size 0x400
0x40000C00 TIM5 size 0x400
0x40001000 TIM6 size 0x400 — Basic timer
0x40001400 TIM7 size 0x400
0x40001800 TIM12 size 0x400
0x40001C00 TIM13 size 0x400
0x40002000 TIM14 size 0x400
0x40002800 RTC size 0x400 — Real time clock
0x40002C00 WWDG size 0x400 — Window watchdog
0x40003000 IWDG size 0x400 — Independent watchdog
0x40003800 SPI2 size 0x400
0x40003C00 SPI3 size 0x400
0x40004400 USART2 size 0x400
0x40004800 USART3 size 0x400
0x40004C00 UART4 size 0x400 — Universal asynchronous receiver transmitter
0x40005000 UART5 size 0x400 — Universal asynchronous receiver transmitter
0x40005400 I2C1 size 0x400 — Inter integrated circuit
0x40005800 I2C2 size 0x400
0x40006C04 BKP size 0x400 — Backup registers
0x40007000 PWR size 0x400 — Power control
0x40007400 DAC size 0x400 — Digital to analog converter
0x40010000 AFIO size 0x400 — Alternate function I/O
0x40010400 EXTI size 0x400
0x40010800 GPIOA size 0x400 — General purpose I/O
0x40010C00 GPIOB size 0x400
0x40011000 GPIOC size 0x400
0x40011400 GPIOD size 0x400
0x40011800 GPIOE size 0x400
0x40011C00 GPIOF size 0x400
0x40012000 GPIOG size 0x400
0x40012400 ADC1 size 0x400 — Analog to digital converter
0x40013000 SPI1 size 0x400 — Serial peripheral interface
0x40013800 USART1 size 0x400 — Universal synchronous asynchronous receiver transmitter
0x40014C00 TIM9 size 0x400 — General purpose timer
0x40015000 TIM10 size 0x400 — General purpose timer
0x40015400 TIM11 size 0x400
0x40020000 DMA1 size 0x400 — DMA controller
0x40020400 DMA2 size 0x400
0x40021000 RCC size 0x400 — Reset and clock control
0x40022000 FLASH size 0x400
0x40023000 CRC size 0x400 — CRC calculation unit
0xA0000000 FSMC size 0x1000 — Flexible static memory controller
0xE000E000 NVIC size 0x1001 — Nested Vectored Interrupt Controller
0xE000ED00 Debug size 0x100
0xE0042000 DBG size 0x400 — Debug support

## Interrupts
0 WWDG (TIM2) — Window Watchdog interrupt
1 PVD (PWR) — PVD through EXTI Line detection interrupt
2 TAMPER_STAMP (EXTI) — Tamper and TimeStamp through EXTI line interrupts
3 RTC_WKUP (RTC) — RTC Wakeup through EXTI line interrupt
4 FLASH (BKP) — Flash global interrupt
5 RCC — RCC global interrupt
6 EXTI0 (EXTI) — EXTI Line0 interrupt
7 EXTI1 (EXTI) — EXTI Line1 interrupt
8 EXTI2 (EXTI) — EXTI Line2 interrupt
9 EXTI3 (EXTI) — EXTI Line3 interrupt
10 EXTI4 (EXTI) — EXTI Line4 interrupt
11 DMA1_Channel1 (DMA1) — DMA1 Channel1 global interrupt
12 DMA1_Channel2 (DMA1) — DMA1 Channel2 global interrupt
13 DMA1_Channel3 (DMA1) — DMA1 Channel3 global interrupt
14 DMA1_Channel4 (DMA1) — DMA1 Channel4 global interrupt
15 DMA1_Channel5 (DMA1) — DMA1 Channel5 global interrupt
16 DMA1_Channel6 (DMA1) — DMA1 Channel6 global interrupt
17 DMA1_Channel7 (DMA1) — DMA1 Channel7 global interrupt
18 ADC_IRQ (ADC1) — ADC1 global interrupt
21 DAC (UART4) — DAC interrupt
22 COMP_CA (EXTI) — Comparator wakeup through EXTI line (21 and 22) interrupt/Channel acquisition interrupt
23 EXTI9_5 (EXTI) — EXTI Line[9:5] interrupts
25 TIM9 (TIM12) — TIM9 global interrupt
26 TIM10 (TIM11) — TIM10 global interrupt
27 TIM11 (TIM13) — TIM11 global interrupt
28 TIM2 (TIM3) — TIM2 global interrupt
29 TIM3 (TIM4) — TIM3 global interrupt
30 TIM4 (TIM5) — TIM4 global interrupt
31 I2C1_EV (I2C2) — I2C1 event interrupt
32 I2C1_ER (I2C2) — I2C1 error interrupt
33 I2C2_EV (SPI1) — I2C2 event interrupt
34 I2C2_ER (SPI1) — I2C2 error interrupt
35 SPI1 (SPI2) — SPI1 global interrupt
36 SPI2 (SPI3) — SPI2 global interrupt
37 USART1 (USART2) — USART1 global interrupt
38 USART2 (USART3) — USART2 global interrupt
39 USART3 (DAC) — USART3 global interrupt
40 EXTI15_10 (EXTI) — EXTI Line[15:10] interrupts
41 RTC_Alarm (RTC) — RTC Alarms (A and B) through EXTI line interrupt
43 TIM6 (TIM7) — TIM6 global interrupt
44 TIM7 (I2C1) — TIM7 global interrupt
46 TIM5 (TIM9) — TIM5 global interrupt
47 SPI3 (USART1) — SPI3 global interrupt
50 DMA2_CH1 (DMA2) — DMA2 Channel 1 interrupt
51 DMA2_CH2 (DMA2) — DMA2 Channel 2 interrupt
52 DMA2_CH3 (DMA2) — DMA2 Channel 3 interrupt
53 DMA2_CH4 (DMA2) — DMA2 Channel 4 interrupt
54 DMA2_CH5 (DMA2) — DMA2 Channel 5 interrupt
